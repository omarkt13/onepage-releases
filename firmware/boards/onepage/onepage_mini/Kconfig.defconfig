## firmware/boards/onepage/onepage_mini/Kconfig.defconfig
```kconfig
if BOARD_ONEPAGE_MINI_NRF54L15_CPUAPP

config ROM_START_OFFSET
	default 0 if PARTITION_MANAGER_ENABLED
	default 0x800 if BOOTLOADER_MCUBOOT

endif
```

## firmware/boards/onepage/onepage_mini/board.yml
```yaml
board:
  name: onepage_mini
  full_name: OnePage Mini
  vendor: onepage
  socs:
  - name: nrf54l15
```
